#include <Adafruit_GFX.h>
#include <Adafruit_ST7789.h>
#include <SPI.h>
#include <OneWire.h>
#include <DallasTemperature.h>

// Screen connection scheme
// VCC → 3.3V (not 5V)
// GND → GNDSCL (SCLK) → D13 (Hardware SPI Clock)
// SDA (MOSI) → D11 (Hardware SPI Data)
// RES (Reset) → D8
// DC (Data/Command) → D9
// BLK → D5

#define TFT_CS -1
#define TFT_RST 8
#define TFT_DC 9
#define TFT_BLK 5

// TFT display init 240x240
Adafruit_ST7789 tft = Adafruit_ST7789(TFT_CS, TFT_DC, TFT_RST);

// Soil sensor
#define SOIL_PIN A0
const int airValue = 571;
const int waterValue = 217;

// Light sensor
#define LIGHT_PIN 2

// Temperature sensor
#define TEMPERATURE_PIN 4
OneWire oneWire(TEMPERATURE_PIN);
DallasTemperature sensors(&oneWire);

// Button
#define TOUCH_PIN 7

// Plant specific params
const int overwateredSoil = 90;
const int drySoil = 20;
const int hotTemp = 30;
const int coldTemp = 10;

// Loop and sleep mode params setup
int tick = 0;
const unsigned int msPerTick = 100;
const unsigned int ticksPerScreenUpdate = 10;
const unsigned long sleepModeTimeout = 600;  // 1 minute (msPerTick * sleepModeTimeout)
bool sleepMode = false;
unsigned long lastInteractionTime = 0;

// Base pixel art
const uint16_t epd_bitmap_aloe[] PROGMEM = {
	0x0000, 0x0000, 0x0000, 0x0000, 0x0000, 0x0000, 0x0000, 0x0000, 0x0000, 0x0000, 0x0000, 0x0000, 0x0000, 0xcfee, 0xcfee, 0xcfee,
	0xcfee, 0xcfee, 0xcfee, 0xcfee, 0xcfee, 0x0000, 0x0000, 0x0000, 0x0000, 0x0000, 0x0000, 0x0000, 0x0000, 0x0000, 0x0000, 0x0000,
	0x0000, 0x0000, 0x0000, 0x0000, 0x0000, 0x0000, 0x0000, 0x0000, 0x0000, 0x0000, 0x0000, 0x0000, 0x0000, 0x0000, 0x0000, 0x0000,
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	0x0000, 0x0000, 0x0000, 0x0000, 0x0000, 0x0000, 0x0000, 0x0000, 0x0000, 0x0000, 0x0000, 0x0000, 0x0000, 0x0000, 0x0000, 0x0000
};

const uint16_t epd_bitmap_smile[] PROGMEM = {
	0xffff, 0x0000, 0x0000, 0xffff, 0xffff, 0xffff, 0xffff, 0xffff, 0xffff, 0xffff, 0xffff, 0x0000, 0x0000, 0xffff,
	0x0000, 0xffff, 0x0000, 0x0000, 0xffff, 0xffff, 0xffff, 0xffff, 0xffff, 0xffff, 0x0000, 0xffff, 0x0000, 0x0000,
	0x0000, 0x0000, 0x0000, 0x0000, 0xffff, 0xffff, 0xffff, 0xffff, 0xffff, 0xffff, 0x0000, 0x0000, 0x0000, 0x0000,
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	0xffff, 0xffff, 0xffff, 0xffff, 0xffff, 0x0000, 0x0000, 0x0000, 0x0000, 0xffff, 0xffff, 0xffff, 0xffff, 0xffff
};

const uint16_t epd_bitmap_sleep[] PROGMEM = {
	0xffff, 0xffff, 0xffff, 0xffff, 0xffff, 0xffff, 0xffff, 0xffff, 0xffff, 0xffff, 0xffff, 0xffff, 0xffff, 0xffff,
	0xffff, 0xffff, 0xffff, 0xffff, 0xffff, 0xffff, 0xffff, 0xffff, 0xffff, 0xffff, 0xffff, 0xffff, 0xffff, 0xffff,
	0x0000, 0xffff, 0xffff, 0x0000, 0xffff, 0xffff, 0xffff, 0xffff, 0xffff, 0xffff, 0x0000, 0xffff, 0xffff, 0x0000,
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	0xffff, 0xffff, 0xffff, 0xffff, 0xffff, 0xffff, 0x0000, 0x0000, 0xffff, 0xffff, 0xffff, 0xffff, 0xffff, 0xffff
};

const uint16_t epd_bitmap_dry[] PROGMEM = {
	0xffff, 0xffff, 0x0000, 0x0000, 0xffff, 0xffff, 0xffff, 0xffff, 0xffff, 0xffff, 0x0000, 0x0000, 0xffff, 0xffff,
	0xffff, 0x0000, 0x0000, 0x0000, 0xffff, 0xffff, 0xffff, 0xffff, 0xffff, 0xffff, 0x0000, 0x0000, 0x0000, 0xffff,
	0x0000, 0x0000, 0x0000, 0xffff, 0xffff, 0xffff, 0xffff, 0xffff, 0xffff, 0xffff, 0xffff, 0x0000, 0x0000, 0x0000,
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	0xffff, 0xffff, 0xffff, 0xffff, 0x0000, 0xffff, 0xffff, 0xffff, 0xffff, 0x0000, 0xffff, 0xffff, 0xffff, 0xffff
};

const uint16_t epd_bitmap_wet[] PROGMEM = {
	0xffff, 0x0000, 0x0000, 0xffff, 0xffff, 0xffff, 0xffff, 0xffff, 0xffff, 0xffff, 0xffff, 0x0000, 0x0000, 0xffff,
	0xffff, 0x0000, 0x0000, 0xffff, 0xffff, 0xffff, 0xffff, 0xffff, 0xffff, 0xffff, 0xffff, 0x0000, 0x0000, 0xffff,
	0xffff, 0xffff, 0xffff, 0xffff, 0xffff, 0xffff, 0xffff, 0xffff, 0xffff, 0xffff, 0xffff, 0xffff, 0xffff, 0xffff,
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	0xffff, 0xffff, 0xffff, 0xffff, 0xffff, 0x0000, 0x0000, 0x0000, 0x0000, 0xffff, 0xffff, 0xffff, 0xffff, 0xffff
};

const uint16_t epd_bitmap_hot[] PROGMEM = {
	0xffff, 0xffff, 0xffff, 0xffff, 0xffff, 0xffff, 0xffff, 0xffff, 0xffff, 0xffff, 0xffff, 0xffff, 0xffff, 0xffff,
	0xffff, 0x0000, 0x0000, 0xffff, 0xffff, 0xffff, 0xffff, 0xffff, 0xffff, 0xffff, 0xffff, 0x0000, 0x0000, 0xffff,
	0xffff, 0x0000, 0x0000, 0xffff, 0xffff, 0xffff, 0xffff, 0xffff, 0xffff, 0xffff, 0xffff, 0x0000, 0x0000, 0xffff,
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	0xffff, 0xffff, 0xffff, 0xffff, 0x0000, 0x0000, 0xf800, 0xf800, 0x0000, 0x0000, 0xffff, 0xffff, 0xffff, 0xffff
};

const uint16_t epd_bitmap_cold[] PROGMEM = {
	0x0000, 0x0000, 0x0000, 0x0000, 0xffff, 0xffff, 0xffff, 0xffff, 0xffff, 0xffff, 0x0000, 0x0000, 0x0000, 0x0000,
	0xffff, 0x0000, 0x0000, 0xffff, 0xffff, 0xffff, 0xffff, 0xffff, 0xffff, 0xffff, 0xffff, 0x0000, 0x0000, 0xffff,
	0xffff, 0x0000, 0x0000, 0xffff, 0xffff, 0xffff, 0xffff, 0xffff, 0xffff, 0xffff, 0xffff, 0x0000, 0x0000, 0xffff,
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	0xffff, 0xffff, 0xffff, 0xffff, 0x0000, 0x0000, 0x0000, 0x0000, 0x0000, 0x0000, 0xffff, 0xffff, 0xffff, 0xffff
};

void drawPlant(uint16_t bitmap[]) {
	const int sizePx = 240;
	const int sizeImg = 48;
	const int scale = 5;
	int xOffset = (sizePx - (sizeImg * scale)) / 2;
	int yOffset = (sizePx - (sizeImg * scale)) / 2;

	for (int y = 0; y < sizeImg; y++) {
		for (int x = 0; x < sizeImg; x++) {
			uint16_t color = pgm_read_word(&bitmap[y * sizeImg + x]);
			tft.fillRect(xOffset + (x * scale), yOffset + (y * scale), scale, scale, color);
		}
	}
	return;
}

void drawFace(uint16_t bitmap[]) {
	const int faceSizeX = 14;
	const int faceSizeY = 8;
	const int scale = 5;
	const int xOffset = 17 * scale;
	const int yOffset = 36 * scale;

	for (int y = 0; y < faceSizeY; y++) {
		for (int x = 0; x < faceSizeX; x++) {
			uint16_t color = pgm_read_word(&bitmap[y * faceSizeX + x]);
			tft.fillRect(xOffset + (x * scale), yOffset + (y * scale), scale, scale, color);
		}
	}
}

int toMoisturePercent(int value) {
	return int((1 - float(value - waterValue) / (airValue - waterValue)) * 100);
}

void setup() {
	// Initialize console (TODO: remove after tests)
	Serial.begin(9600);

	// Initialize light sensor
	pinMode(LIGHT_PIN, INPUT);
	sensors.begin();

	// Initialize touch button
	pinMode(TOUCH_PIN, INPUT);

	// Initialize tft screen
	pinMode(TFT_BLK, OUTPUT);
	digitalWrite(TFT_BLK, HIGH);
	tft.init(240, 240, SPI_MODE3);
	tft.setRotation(2);

	// Write greetings message
	tft.fillScreen(ST77XX_BLACK);
	tft.setCursor(20, 100);
	tft.setTextColor(ST77XX_WHITE);
	tft.setTextSize(3);
	tft.println("HELLO, ALOE");

	delay(1000);

	tft.setTextSize(2);
	tft.fillScreen(ST77XX_BLACK);
	drawPlant(epd_bitmap_aloe);
}

void updateScreen() {
	tft.fillRect(180, 192, 60, 64, ST77XX_BLACK);

	uint16_t emotion = epd_bitmap_smile;

	// Light sensor
	int lightSensorState = digitalRead(LIGHT_PIN);
	if (lightSensorState == LOW) {
		tft.setCursor(200, 192);
		tft.println("day");
	} else {
		tft.setCursor(180, 192);
		tft.println("night");
		emotion = epd_bitmap_sleep;
	}

	// Soil sensor
	int soilSensorValue = analogRead(SOIL_PIN);
	int soilMoisture = toMoisturePercent(soilSensorValue);
	tft.setCursor(200, 208);
	tft.print(soilMoisture);
	tft.println("%");
	if (soilMoisture < drySoil) {
		emotion = epd_bitmap_dry;
	} else if (soilMoisture > overwateredSoil) {
		emotion = epd_bitmap_wet;
	}

	// Temperature sensor
	sensors.requestTemperatures();
	float tempC = sensors.getTempCByIndex(0);
	if (tempC != DEVICE_DISCONNECTED_C) {
		tft.setCursor(180, 224);
		tft.print(tempC);

		if (tempC > hotTemp) {
			emotion = epd_bitmap_hot;
		} else if (tempC < coldTemp) {
			emotion = epd_bitmap_cold;
		}
	}

	drawFace(emotion);
}

void loop() {
	if (tick == ticksPerScreenUpdate) {
		tick = 0;
		updateScreen();
	}

	tick += 1;

	// Button
	int touchState = digitalRead(TOUCH_PIN);
	if (touchState == HIGH) {
		Serial.println("touch");
		lastInteractionTime = 0;
		// Wake up
		digitalWrite(TFT_BLK, HIGH);
		tft.writeCommand(0x11);
	} else if (lastInteractionTime < sleepModeTimeout) {
		lastInteractionTime += 1;
	} else if (lastInteractionTime == sleepModeTimeout) {
		// Send the display driver to sleep
		digitalWrite(TFT_BLK, LOW);
		tft.writeCommand(0x10);
	}

	delay(msPerTick);
}
